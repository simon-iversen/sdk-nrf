## CMakeLists.txt
```
# SPDX-License-Identifier: Apache-2.0

cmake_minimum_required(VERSION 3.13.1)

find_package(Zephyr REQUIRED HINTS $ENV{ZEPHYR_BASE})
project(temperature)

target_sources(app PRIVATE src/main.c)
```

## prj.conf
```kconfig
# nothing here
CONFIG_NRFX_TEMP=y
```

## src/main.c
```c
/*
 * Copyright (c) 2012-2014 Wind River Systems, Inc.
 *
 * SPDX-License-Identifier: Apache-2.0
 */

#include <zephyr.h>
#include <sys/printk.h>
#include <nrfx_temp.h>


void temp_handler(int32_t temperature)
{ 
    printk("Temperature (Celcius): %d \n",temperature / 4);
}

void main(void)
{
	int err = 0;

	printk("Temperature sample started\n");

	nrfx_temp_config_t temp_config = NRFX_TEMP_DEFAULT_CONFIG;
        
        err = nrfx_temp_init(&temp_config,temp_handler);
	IRQ_CONNECT(TEMP_IRQn,5,nrfx_temp_irq_handler,NULL,0);
        if (err!=NRFX_SUCCESS) 
	{	
		printk("error %d\n", err);
	}
	while(true){
		err= nrfx_temp_measure();
		k_sleep(K_MSEC(2000));
	}

}
```
